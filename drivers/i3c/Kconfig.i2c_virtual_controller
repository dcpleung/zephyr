## drivers/i3c/Kconfig.i2c_virtual_controller
```kconfig
# Copyright (c) 2022 Intel Corporation
#
# SPDX-License-Identifier: Apache-2.0

DT_COMPAT_I2C_VIRTUAL_CONTROLLER := virtual,i3c-i2c-controller

config I3C_I2C_VIRTUAL_CONTROLLER
	bool "I2C Virtual Bridge"
	default $(dt_compat_enabled,$(DT_COMPAT_I2C_VIRTUAL_CONTROLLER))
	help
	  Enable the I2C virtual controller driver to allow device drivers
	  using I2C to be interfaced with the I3C controller without
	  changes.
```

## dts/bindings/i3c/virtual,i3c-i2c-controller.yaml
```yaml
# Copyright (c) 2022 Intel Corporation
#
# SPDX-License-Identifier: Apache-2.0

# Fields for I2C Virtual Controller under I3C Bus

description: I2C Virtual Controller under I3C Bus

compatible: "virtual,i3c-i2c-controller"

include: base.yaml

bus: i2c

properties:
    "#address-cells":
      required: true
      const: 1

    "#size-cells":
      required: true
      const: 0

    lvr:
      type: int
      required: true
      description: |
        Common LVR (Legacy Virtual Register) for all I2C devices under
        this virtual controller.
```

## kernel/Kconfig
```kconfig
# Kernel configuration options

# Copyright (c) 2014-2015 Wind River Systems, Inc.
# SPDX-License-Identifier: Apache-2.0

menu "General Kernel Options"

module = KERNEL
module-str = kernel
source "subsys/logging/Kconfig.template.log_config"

rsource "core/Kconfig"
rsource "ipc/Kconfig"
rsource "timing/Kconfig"
rsource "misc/Kconfig"
rsource "memory/Kconfig"

rsource "Kconfig.obj_core"

rsource "userspace/Kconfig"
rsource "smp/Kconfig"

endmenu

rsource "Kconfig.device"
rsource "Kconfig.vm"
rsource "Kconfig.init"

# The remainder of this file is intentionally empty; all config symbols have
# been moved into the subsystem Kconfig fragments above.
```
