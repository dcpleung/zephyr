## kernel/misc/Kconfig
```kconfig
# SPDX-License-Identifier: Apache-2.0
# Copyright (c) The Zephyr Project Contributors

menu "Misc Kernel related options"

config LIBC_ERRNO
	bool
	help
	  Use external libc errno, not the internal one. This eliminates any
	  locally allocated errno storage and usage.

config ERRNO
	bool "Errno support"
	default y
	help
	  Enable per-thread errno in the kernel. Application and library code must
	  include errno.h provided by the C library (libc) to use the errno
	  symbol. The C library must access the per-thread errno via the
	  z_errno() symbol.

config ERRNO_IN_TLS
	bool "Store errno in thread local storage (TLS)"
	depends on ERRNO && THREAD_LOCAL_STORAGE && !LIBC_ERRNO
	default y
	help
	  Use thread local storage to store errno instead of storing it in
	  the kernel thread struct. This avoids a syscall if userspace is enabled.

config CURRENT_THREAD_USE_NO_TLS
	bool
	help
	  Hidden symbol to not use thread local storage to store current
	  thread.

config CURRENT_THREAD_USE_TLS
	bool "Store current thread in thread local storage (TLS)"
	depends on THREAD_LOCAL_STORAGE && !CURRENT_THREAD_USE_NO_TLS
	default y
	help
	  Use thread local storage to store the current thread. This avoids a
	  syscall if userspace is enabled.

config NONZERO_SPINLOCK_SIZE
	bool "Force spinlock to have non-zero size"
	help
	  This option indicates that the spinlock structure must have a
	  non-zero size (such as if used in an array). It is automatically
	  selected when using C++.

endmenu

menu "Kernel Debugging and Metrics"

config INIT_STACKS
	bool "Initialize stack areas"
	help
	  This option instructs the kernel to initialize stack areas with a
	  known value (0xaa) before they are first used, so that the high
	  water mark can be easily determined. This applies to the stack areas
	  for threads, as well as to the interrupt stack.

config SKIP_BSS_CLEAR
	bool
	help
	  This option disables software .bss section zeroing during Zephyr
	  initialization. Such boot-time optimization could be used for
	  platforms where .bss section is zeroed-out externally.
	  Please pay attention that when this option is enabled
	  the responsibility for .bss zeroing in all possible scenarios
	  (mind e.g. SW reset) is delegated to the external SW or HW.

config BOOT_BANNER
	bool "Boot banner"
	default y
	select PRINTK
	select EARLY_CONSOLE
	help
	  This option outputs a banner to the console device during boot up.

config BOOT_BANNER_STRING
	string "Boot banner string"
	depends on BOOT_BANNER
	default "Booting Zephyr OS build"
	help
	  Use this option to set the boot banner.

config BOOT_DELAY
	int "Boot delay in milliseconds"
	depends on MULTITHREADING
	default 0
	help
	  This option delays bootup for the specified amount of
	  milliseconds. This is used to allow serial ports to get ready
	  before starting to print information on them during boot, as
	  some systems might boot to fast for a receiving endpoint to
	  detect the new USB serial bus, enumerate it and get ready to
	  receive before it actually gets data. A similar effect can be
	  achieved by waiting for DCD on the serial port--however, not
	  all serial ports have DCD.

config BOOT_CLEAR_SCREEN
	bool "Clear screen"
	help
	  Use this option to clear the screen before printing anything else.
	  Using a VT100 enabled terminal on the client side is required for this to work.

config THREAD_MONITOR
	bool "Thread monitoring"
	help
	  This option instructs the kernel to maintain a list of all threads
	  (excluding those that have not yet started or have already
	  terminated).

config THREAD_NAME
	bool "Thread name"
	help
	  This option allows to set a name for a thread.

config THREAD_MAX_NAME_LEN
	int "Max length of a thread name"
	default 32
	default 64 if ZTEST
	range 8 128
	depends on THREAD_NAME
	help
	  Thread names get stored in the k_thread struct. Indicate the max
	  name length, including the terminating NULL byte. Reduce this value
	  to conserve memory.

config INSTRUMENT_THREAD_SWITCHING
	bool

menuconfig THREAD_RUNTIME_STATS
	bool "Thread runtime statistics"
	help
	  Gather thread runtime statistics.

	  For example:
	    - Thread total execution cycles
	    - System total execution cycles

if THREAD_RUNTIME_STATS

config THREAD_RUNTIME_STATS_USE_TIMING_FUNCTIONS
	bool "Use timing functions to gather statistics"
	select TIMING_FUNCTIONS_NEED_AT_BOOT
	help
	  Use timing functions to gather thread runtime statistics.

	  Note that timing functions may use a different timer than
	  the default timer for OS timekeeping.

config SCHED_THREAD_USAGE
	bool "Collect thread runtime usage"
	default y
	select INSTRUMENT_THREAD_SWITCHING if !USE_SWITCH
	help
	  Collect thread runtime info at context switch time

config SCHED_THREAD_USAGE_ANALYSIS
	bool "Analyze the collected thread runtime usage statistics"
	default n
	depends on SCHED_THREAD_USAGE
	select INSTRUMENT_THREAD_SWITCHING if !USE_SWITCH
	help
	  Collect additional timing information related to thread scheduling
	  for analysis purposes. This includes the total time that a thread
	  has been scheduled, the longest time for which it was scheduled and
	  others.

config SCHED_THREAD_USAGE_ALL
	bool "Collect total system runtime usage"
	default y if SCHED_THREAD_USAGE
	depends on SCHED_THREAD_USAGE
	help
	  Maintain a sum of all non-idle thread cycle usage.

config SCHED_THREAD_USAGE_AUTO_ENABLE
	bool "Automatically enable runtime usage statistics"
	default y
	depends on SCHED_THREAD_USAGE
	help
	  When set, this option automatically enables the gathering of both
	  the thread and CPU usage statistics.

endif # THREAD_RUNTIME_STATS

menuconfig THREAD_RUNTIME_STACK_SAFETY
	bool "Thread runtime stack safety support"
	default n
	help
	  This option enables support for the thread runtime stack safety check routines.
	  These routines are used to  detect a thread's unused stack space and invoke a
	  user-defined handler if it was found to have dropped below a configured threshold.

if THREAD_RUNTIME_STACK_SAFETY

config THREAD_RUNTIME_STACK_SAFETY_DEFAULT_UNUSED_THRESHOLD_PCT
	int "Runtime Stack Safety unused stack usage percentage threshold"
	default 0
	range 0 99
	help
	  This option specifies a thread's default runtime stack safety
	  threshold as a percentage of the stack size. When the runtime stack
	  safety routines detect that a thread's unused stack percentage has fallen
	  _below_ this threshold, a user-defined handler is invoked.
	  Setting this to 0 disables the check by default for all threads.

endif

endmenu

menu "Barrier Operations"

config BARRIER_OPERATIONS_BUILTIN
	bool
	help
	  Use the compiler builtin functions for barrier operations. This is
	  the preferred method. However, support for all arches in GCC is
	  incomplete.

config BARRIER_OPERATIONS_ARCH
	bool
	help
	  Use when there isn't support for compiler built-ins, but you have
	  written optimized assembly code under arch/ which implements these.

endmenu

menu "Atomic Operations"

config ATOMIC_OPERATIONS_BUILTIN
	bool
	help
	  Use the compiler builtin functions for atomic operations. This is
	  the preferred method. However, support for all arches in GCC is
	  incomplete.

config ATOMIC_OPERATIONS_ARCH
	bool
	help
	  Use when there isn't support for compiler built-ins, but you have
	  written optimized assembly code under arch/ which implements these.

config ATOMIC_OPERATIONS_C
	bool
	help
	  Use atomic operations routines that are implemented entirely
	  in C by locking interrupts. Selected by architectures which either
	  do not have support for atomic operations in their instruction
	  set, or haven't been implemented yet during bring-up, and also
	  the compiler does not have support for the atomic __sync_* builtins.

endmenu

menu "Security Options"

config REQUIRES_STACK_CANARIES
	bool
	help
	  Hidden option to signal that software stack protection is required.

choice
	prompt "Stack canaries protection options"
	optional
	help
	  If stack canaries are supported by the compiler, it will emit
	  extra code that inserts a canary value into the stack frame when
	  a function is entered and validates this value upon exit.
	  Stack corruption (such as that caused by buffer overflow) results
	  in a fatal error condition for the running entity.
	  Enabling this option, depending on the level chosen, can result in a
	  significant increase in footprint and a corresponding decrease in performance.

	  If stack canaries are not supported by the compiler an error
	  will occur at build time.

config STACK_CANARIES
	bool "Default protection"
	depends on ENTROPY_GENERATOR || TEST_RANDOM_GENERATOR
	select NEED_LIBC_MEM_PARTITION if !STACK_CANARIES_TLS
	select REQUIRES_STACK_CANARIES
	help
	  This option enables compiler stack canaries in functions that have
	  vulnerable objects. Generally this means function that call alloca or
	  have buffers larger than 8 bytes.

config STACK_CANARIES_STRONG
	bool "Strong protection"
	depends on ENTROPY_GENERATOR || TEST_RANDOM_GENERATOR
	select NEED_LIBC_MEM_PARTITION if !STACK_CANARIES_TLS
	select REQUIRES_STACK_CANARIES
	help
	  This option enables compiler stack canaries in functions that call alloca,
	  functions that have local array definition or have references to local
	  frame addresses.

config STACK_CANARIES_ALL
	bool "Maximum protection available"
	depends on ENTROPY_GENERATOR || TEST_RANDOM_GENERATOR
	select NEED_LIBC_MEM_PARTITION if !STACK_CANARIES_TLS
	select REQUIRES_STACK_CANARIES
	help
	  This option enables compiler stack canaries for all functions.

config STACK_CANARIES_EXPLICIT
	bool "Explicit protection"
	depends on ENTROPY_GENERATOR || TEST_RANDOM_GENERATOR
	depends on "$(ZEPHYR_TOOLCHAIN_VARIANT)" = "zephyr"
	select NEED_LIBC_MEM_PARTITION if !STACK_CANARIES_TLS
	select REQUIRES_STACK_CANARIES
	help
	  This option enables compiler stack canaries only in functions which have the
	  stack_protect attribute.

endchoice

if REQUIRES_STACK_CANARIES

config STACK_CANARIES_TLS
	bool "Stack canaries using thread local storage"
	depends on THREAD_LOCAL_STORAGE
	depends on ARCH_HAS_STACK_CANARIES_TLS
	help
	  This option enables compiler stack canaries on TLS.

	  Stack canaries will leave in the thread local storage and
	  each thread will have its own canary. This makes harder
	  to predict the canary location and value.

	  When enabled this causes an additional performance penalty
	  during thread creations because it needs a new random value
	  per thread.

endif

config STACK_POINTER_RANDOM
	int "Initial stack pointer randomization bounds"
	depends on !STACK_GROWS_UP
	depends on MULTITHREADING
	depends on TEST_RANDOM_GENERATOR || ENTROPY_HAS_DRIVER
	default 0
	help
	  This option performs a limited form of Address Space Layout
	  Randomization by offsetting some random value to a thread's
	  initial stack pointer upon creation. This hinders some types of
	  security attacks by making the location of any given stack frame
	  non-deterministic.

	  This feature can waste up to the specified size in bytes the stack
	  region, which is carved out of the total size of the stack region.
	  A reasonable minimum value would be around 100 bytes if this can
	  be spared.

	  This is currently only implemented for systems whose stack pointers
	  grow towards lower memory addresses.

config HW_SHADOW_STACK
	bool "Use hardware shadow stack mechanism to provide stack protection [EXPERIMENTAL]"
	depends on ARCH_HAS_HW_SHADOW_STACK
	select EXPERIMENTAL
	help
	  This option enables the use of hardware shadow stack to provide
	  stack protection. When enabled, threads that provide a shadow stack
	  will use the hardware shadow stack to store the return address of
	  function calls. This will help to protect against return-oriented
	  programming (ROP) attacks.

	  Currently, not all threads created by the kernel will have a shadow
	  stack. Indeed, threads need to manually attach a shadow stack to
	  use this feature. See the documentation for more information.

config HW_SHADOW_STACK_PERCENTAGE_SIZE
	int "Percentage of the stack size used to define shadow stack size"
	depends on HW_SHADOW_STACK
	default 30
	range 0 100
	help
	  This option specifies the percentage of the stack to be used for
	  shadow stack. The value is a percentage of the total stack size.
	  The default value is 30%, which means that the shadow stack size
	  will be 30% of the stack size, in *addition* to the stack size.
	  used for shadow stack. Note that this size is constrained by the
	  HW_SHADOW_STACK_MIN_SIZE config option.

config HW_SHADOW_STACK_MIN_SIZE
	int "Minimum size of the hardware shadow stack"
	depends on HW_SHADOW_STACK
	default 256
	help
	  This option specifies the minimum size of the hardware shadow stack,
	  in bytes, so that threads that use minimal stack size can still
	  have a sensible shadow stack size. The default value is 256 bytes,
	  which means that the shadow stack size will be at least 256 bytes,
	  even if the percentage defined via HW_SHADOW_STACK_PERCENTAGE_SIZE
	  would define a smaller size.

config HW_SHADOW_STACK_ALLOW_REUSE
	bool "Allow reuse of the shadow stack"
	depends on HW_SHADOW_STACK
	default y if ZTEST
	help
	  This option allows the reuse of the shadow stack. This is meant to
	  accommodate thread reuse, when the same thread is created again,
	  such as done by the test suite. It is not meant to be used to share
	  the shadow stack between threads.

endmenu

menuconfig BOOTARGS
	bool "Support bootargs"
	help
	  Enables bootargs support and passing them to main().

if BOOTARGS

config DYNAMIC_BOOTARGS
	bool "Support dynamic bootargs"
	help
	  Enables dynamic bootargs support.

config BOOTARGS_STRING
	string "static bootargs string"
	depends on !DYNAMIC_BOOTARGS
	help
	  Static bootargs string. It includes argv[0], so if its expected that it
	  contains executable name it should be put at the beginning of this string.

config BOOTARGS_ARGS_BUFFER_SIZE
	int "Size of buffer containing main arguments in bytes"
	default 1024
	help
	  Configures size of buffer containing all arguments passed to main.

endif # BOOTARGS
```
